#include "bsp_ili9341.h"
#include "stdio.h"
#include "stm32f10x.h"  // 必须添加，标准库头文件

// 声明延时函数
void Delay_ms(uint32_t ms);

// ==================== 基础配置 ====================
#define ILI9341_WIDTH   240
#define ILI9341_HEIGHT  320

// 标准颜色定义
#define ILI9341_BLACK   0x0000
#define ILI9341_BLUE    0x001F
#define ILI9341_RED     0xF800
#define ILI9341_GREEN   0x07E0
#define ILI9341_CYAN    0x07FF
#define ILI9341_MAGENTA 0xF81F
#define ILI9341_YELLOW  0xFFE0
#define ILI9341_WHITE   0xFFFF

// 你的引脚定义（完全不变）
#define ILI9341_CS_GPIO_PORT    GPIOA
#define ILI9341_CS_GPIO_PIN     GPIO_Pin_5
#define ILI9341_DC_GPIO_PORT    GPIOA
#define ILI9341_DC_GPIO_PIN     GPIO_Pin_6
#define ILI9341_RST_GPIO_PORT   GPIOA
#define ILI9341_RST_GPIO_PIN    GPIO_Pin_7
#define ILI9341_BL_GPIO_PORT    GPIOB
#define ILI9341_BL_GPIO_PIN     GPIO_Pin_0

#define ILI9341_SPI             SPI2

// ILI9341 命令
#define ILI9341_SWRESET   0x01
#define ILI9341_SLPOUT    0x11
#define ILI9341_PIXFMT    0x3A
#define ILI9341_MADCTL    0x36
#define ILI9341_DISPON    0x29
#define ILI9341_CASET     0x2A
#define ILI9341_PASET     0x2B
#define ILI9341_RAMWR     0x2C

// ==================== 引脚操作 ====================
static void ILI9341_CS_LOW(void)  { GPIO_ResetBits(ILI9341_CS_GPIO_PORT, ILI9341_CS_GPIO_PIN); }
static void ILI9341_CS_HIGH(void) { GPIO_SetBits(ILI9341_CS_GPIO_PORT, ILI9341_CS_GPIO_PIN); }
static void ILI9341_DC_LOW(void)  { GPIO_ResetBits(ILI9341_DC_GPIO_PORT, ILI9341_DC_GPIO_PIN); }
static void ILI9341_DC_HIGH(void) { GPIO_SetBits(ILI9341_DC_GPIO_PORT, ILI9341_DC_GPIO_PIN); }
static void ILI9341_RST_LOW(void) { GPIO_ResetBits(ILI9341_RST_GPIO_PORT, ILI9341_RST_GPIO_PIN); }
static void ILI9341_RST_HIGH(void){ GPIO_SetBits(ILI9341_RST_GPIO_PORT, ILI9341_RST_GPIO_PIN); }
static void ILI9341_BL_ON(void)   { GPIO_SetBits(ILI9341_BL_GPIO_PORT, ILI9341_BL_GPIO_PIN); }

// ==================== 优化SPI函数（提高速度）====================
static void ILI9341_SPI_Send(uint8_t data) {
    SPI_I2S_SendData(ILI9341_SPI, data);
    while(SPI_I2S_GetFlagStatus(ILI9341_SPI, SPI_I2S_FLAG_TXE) == RESET);
}

// 发送命令/数据
static void ILI9341_SendCommand(uint8_t cmd) { ILI9341_DC_LOW(); ILI9341_CS_LOW(); ILI9341_SPI_Send(cmd); ILI9341_CS_HIGH(); }
static void ILI9341_SendData(uint8_t data)   { ILI9341_DC_HIGH(); ILI9341_CS_LOW(); ILI9341_SPI_Send(data); ILI9341_CS_HIGH(); }

// 设置显示窗口
static void ILI9341_SetWindow(uint16_t x1, uint16_t y1, uint16_t x2, uint16_t y2) {
    ILI9341_SendCommand(ILI9341_CASET);
    ILI9341_SendData(x1>>8); ILI9341_SendData(x1&0xFF);
    ILI9341_SendData(x2>>8); ILI9341_SendData(x2&0xFF);

    ILI9341_SendCommand(ILI9341_PASET);
    ILI9341_SendData(y1>>8); ILI9341_SendData(y1&0xFF);
    ILI9341_SendData(y2>>8); ILI9341_SendData(y2&0xFF);

    ILI9341_SendCommand(ILI9341_RAMWR);
}

// ==================== 屏幕初始化（兼容所有ILI9341，不白屏）====================
void ILI9341_Init(void) {
    GPIO_InitTypeDef GPIO_InitStruct;
    SPI_InitTypeDef SPI_InitStruct;

    RCC_APB2PeriphClockCmd(RCC_APB2Periph_GPIOA | RCC_APB2Periph_GPIOB, ENABLE);
    RCC_APB1PeriphClockCmd(RCC_APB1Periph_SPI2, ENABLE);

    GPIO_InitStruct.GPIO_Pin = ILI9341_CS_GPIO_PIN | ILI9341_DC_GPIO_PIN | ILI9341_RST_GPIO_PIN;
    GPIO_InitStruct.GPIO_Mode = GPIO_Mode_Out_PP;
    GPIO_InitStruct.GPIO_Speed = GPIO_Speed_50MHz;
    GPIO_Init(GPIOA, &GPIO_InitStruct);

    GPIO_InitStruct.GPIO_Pin = ILI9341_BL_GPIO_PIN;
    GPIO_Init(GPIOB, &GPIO_InitStruct);

    GPIO_InitStruct.GPIO_Pin = GPIO_Pin_13 | GPIO_Pin_15;
    GPIO_InitStruct.GPIO_Mode = GPIO_Mode_AF_PP;
    GPIO_InitStruct.GPIO_Speed = GPIO_Speed_50MHz;
    GPIO_Init(GPIOB, &GPIO_InitStruct);

    SPI_InitStruct.SPI_Direction = SPI_Direction_1Line_Tx;
    SPI_InitStruct.SPI_Mode = SPI_Mode_Master;
    SPI_InitStruct.SPI_DataSize = SPI_DataSize_8b;
    SPI_InitStruct.SPI_CPOL = SPI_CPOL_Low;
    SPI_InitStruct.SPI_CPHA = SPI_CPHA_1Edge;
    SPI_InitStruct.SPI_NSS = SPI_NSS_Soft;
    SPI_InitStruct.SPI_BaudRatePrescaler = SPI_BaudRatePrescaler_4; 
    SPI_InitStruct.SPI_FirstBit = SPI_FirstBit_MSB;
    SPI_Init(ILI9341_SPI, &SPI_InitStruct);
    SPI_Cmd(ILI9341_SPI, ENABLE);

    ILI9341_RST_LOW();
    Delay_ms(200);
    ILI9341_RST_HIGH();
    Delay_ms(200);

    ILI9341_SendCommand(ILI9341_SWRESET); Delay_ms(150);
    ILI9341_SendCommand(ILI9341_SLPOUT);  Delay_ms(200);

    ILI9341_SendCommand(ILI9341_PIXFMT);
    ILI9341_SendData(0x55);

    ILI9341_SendCommand(ILI9341_MADCTL);
    ILI9341_SendData(0x48);  

    ILI9341_SendCommand(ILI9341_DISPON);
    Delay_ms(100);

    ILI9341_BL_ON();
    ILI9341_Clear(ILI9341_BLACK);
}

void ILI9341_Clear(uint16_t color) {
    ILI9341_SetWindow(0, 0, ILI9341_WIDTH-1, ILI9341_HEIGHT-1);
    ILI9341_DC_HIGH();
    ILI9341_CS_LOW();
    uint32_t i = 320*240;
    while(i--) {
        ILI9341_SPI_Send(color >> 8);
        ILI9341_SPI_Send(color & 0xFF);
    }
    ILI9341_CS_HIGH();
}

void ILI9341_DrawPixel(uint16_t x, uint16_t y, uint16_t color) {
    if(x >= 240 || y >= 320) return;
    ILI9341_SetWindow(x,y,x,y);
    ILI9341_DC_HIGH();
    ILI9341_CS_LOW();
    ILI9341_SPI_Send(color>>8);
    ILI9341_SPI_Send(color&0xFF);
    ILI9341_CS_HIGH();
}

// ==================== Basic drawing primitives ====================
void ILI9341_FillRect(uint16_t x1, uint16_t y1, uint16_t x2, uint16_t y2, uint16_t color) {
    uint32_t pixels;

    if (x1 >= ILI9341_WIDTH || y1 >= ILI9341_HEIGHT) return;
    if (x2 >= ILI9341_WIDTH) x2 = ILI9341_WIDTH - 1;
    if (y2 >= ILI9341_HEIGHT) y2 = ILI9341_HEIGHT - 1;
    if (x2 < x1 || y2 < y1) return;

    pixels = (uint32_t)(x2 - x1 + 1) * (uint32_t)(y2 - y1 + 1);
    ILI9341_SetWindow(x1, y1, x2, y2);
    ILI9341_DC_HIGH();
    ILI9341_CS_LOW();
    while (pixels--) {
        ILI9341_SPI_Send(color >> 8);
        ILI9341_SPI_Send(color & 0xFF);
    }
    ILI9341_CS_HIGH();
}

void ILI9341_DrawLine(uint16_t x1, uint16_t y1, uint16_t x2, uint16_t y2, uint16_t color) {
    int16_t dx, dy, sx, sy, err, e2;

    if (x1 == x2) {
        if (y2 < y1) {
            uint16_t t = y1;
            y1 = y2;
            y2 = t;
        }
        ILI9341_FillRect(x1, y1, x2, y2, color);
        return;
    }

    if (y1 == y2) {
        if (x2 < x1) {
            uint16_t t = x1;
            x1 = x2;
            x2 = t;
        }
        ILI9341_FillRect(x1, y1, x2, y2, color);
        return;
    }

    dx = (x1 > x2) ? (int16_t)(x1 - x2) : (int16_t)(x2 - x1);
    dy = (y1 > y2) ? (int16_t)(y1 - y2) : (int16_t)(y2 - y1);
    sx = (x1 < x2) ? 1 : -1;
    sy = (y1 < y2) ? 1 : -1;
    err = (dx > dy ? dx : -dy) / 2;

    while (1) {
        ILI9341_DrawPixel(x1, y1, color);
        if (x1 == x2 && y1 == y2) break;
        e2 = err;
        if (e2 > -dx) {
            err -= dy;
            x1 = (uint16_t)((int16_t)x1 + sx);
        }
        if (e2 < dy) {
            err += dx;
            y1 = (uint16_t)((int16_t)y1 + sy);
        }
    }
}

void ILI9341_DrawRect(uint16_t x1, uint16_t y1, uint16_t x2, uint16_t y2, uint16_t color) {
    ILI9341_DrawLine(x1, y1, x2, y1, color);
    ILI9341_DrawLine(x2, y1, x2, y2, color);
    ILI9341_DrawLine(x2, y2, x1, y2, color);
    ILI9341_DrawLine(x1, y2, x1, y1, color);
}

// ==================== 标准 8x16 ASCII 字库 ====================
void ILI9341_PutChar(uint16_t x, uint16_t y, char c, uint16_t color, uint16_t bg, uint8_t size) {
    static const uint8_t font8x16[96][16] = {
        {0x00,0x00,0x00,0x00,0x00,0x00,0x00,0x00,0x00,0x00,0x00,0x00,0x00,0x00,0x00,0x00},// [sp]
        {0x00,0x00,0x00,0x10,0x10,0x10,0x10,0x10,0x10,0x10,0x00,0x10,0x10,0x00,0x00,0x00},// !
        {0x00,0x28,0x28,0x28,0x00,0x00,0x00,0x00,0x00,0x00,0x00,0x00,0x00,0x00,0x00,0x00},// "
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        {0x00,0x00,0x00,0x00,0x00,0x00,0x00,0x00,0x00,0x00,0x00,0x00,0x00,0x00,0x00,0x00} // DEL
    };
    if (c < 32 || c > 127) c = 32;
    uint8_t index = c - 32;
    for (uint8_t y_pos=0; y_pos<16; y_pos++) {
        uint8_t row = font8x16[index][y_pos];
        for (uint8_t x_pos=0; x_pos<8; x_pos++) {
            if (row & (0x80 >> x_pos)) {
                for (uint8_t i = 0; i < size; i++) {
                    for (uint8_t j = 0; j < size; j++) {
                        ILI9341_DrawPixel(x + x_pos * size + i, y + y_pos * size + j, color);
                    }
                }
            } else {
                for (uint8_t i = 0; i < size; i++) {
                    for (uint8_t j = 0; j < size; j++) {
                        ILI9341_DrawPixel(x + x_pos * size + i, y + y_pos * size + j, bg);
                    }
                }
            }
        }
    }
}

void ILI9341_PutRMin(uint16_t x, uint16_t y, uint16_t color, uint16_t bg, uint8_t size) {
    static const uint8_t glyph_r[16] = {0x00,0x00,0x00,0x00,0x00,0x2C,0x30,0x20,0x20,0x20,0x20,0x20,0x00,0x00,0x00,0x00};
    static const uint8_t glyph_slash[16] = {0x00,0x00,0x00,0x00,0x04,0x04,0x08,0x10,0x20,0x40,0x40,0x00,0x00,0x00,0x00,0x00};
    static const uint8_t glyph_m[16] = {0x00,0x00,0x00,0x00,0x00,0x6C,0x92,0x92,0x92,0x92,0x92,0x92,0x00,0x00,0x00,0x00};
    static const uint8_t glyph_i[16] = {0x00,0x00,0x00,0x10,0x00,0x30,0x10,0x10,0x10,0x10,0x10,0x38,0x00,0x00,0x00,0x00};
    static const uint8_t glyph_n[16] = {0x00,0x00,0x00,0x00,0x00,0x58,0x64,0x44,0x44,0x44,0x44,0x44,0x00,0x00,0x00,0x00};
    const uint8_t *glyphs[5] = {glyph_r, glyph_slash, glyph_m, glyph_i, glyph_n};

    for (uint8_t g = 0; g < 5; g++) {
        for (uint8_t y_pos = 0; y_pos < 16; y_pos++) {
            uint8_t row = glyphs[g][y_pos];
            for (uint8_t x_pos = 0; x_pos < 8; x_pos++) {
                uint16_t pixel_color = (row & (0x80U >> x_pos)) ? color : bg;
                for (uint8_t i = 0; i < size; i++) {
                    for (uint8_t j = 0; j < size; j++) {
                        ILI9341_DrawPixel(
                            x + g * 8U * size + x_pos * size + i,
                            y + y_pos * size + j,
                            pixel_color
                        );
                    }
                }
            }
        }
    }
}

typedef struct {
    uint16_t codepoint;
    uint16_t rows[16];
} ILI9341_Glyph16;

static const ILI9341_Glyph16 ILI9341_GLYPH16_TABLE[] = {
    {0x4E0A, {0x0100,0x0100,0x0100,0x0100,0x01F8,0x0100,0x0100,0x0100,0x0100,0x0100,0x0100,0x0100,0x7FFC,0x0000,0x0000,0x0000}},
    {0x4E0B, {0x7FFC,0x0200,0x0200,0x0200,0x0240,0x0220,0x0210,0x0210,0x0200,0x0200,0x0200,0x0200,0x0200,0x0000,0x0000,0x0000}},
    {0x4F4D, {0x0840,0x0840,0x13F8,0x1000,0x3010,0x5210,0x1210,0x1110,0x1120,0x1120,0x1020,0x1040,0x17FC,0x0000,0x0000,0x0000}},
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    {0x964D, {0x3CF8,0x2508,0x2690,0x2860,0x2890,0x270C,0x2420,0x24F8,0x2420,0x3920,0x21FC,0x2020,0x2020,0x0000,0x0000,0x0000}},
};

static const uint16_t* ILI9341_FindGlyph16(uint16_t codepoint) {
    for (uint32_t i = 0; i < (sizeof(ILI9341_GLYPH16_TABLE) / sizeof(ILI9341_GLYPH16_TABLE[0])); i++) {
        if (ILI9341_GLYPH16_TABLE[i].codepoint == codepoint) return ILI9341_GLYPH16_TABLE[i].rows;
    }
    return 0;
}

static void ILI9341_PutGlyph16(uint16_t x, uint16_t y, const uint16_t rows[16], uint16_t color, uint16_t bg, uint8_t size) {
    for (uint8_t y_pos = 0; y_pos < 16; y_pos++) {
        uint16_t row = rows[y_pos];
        for (uint8_t x_pos = 0; x_pos < 16; x_pos++) {
            uint16_t px = (row & (0x8000 >> x_pos)) ? color : bg;
            for (uint8_t i = 0; i < size; i++) {
                for (uint8_t j = 0; j < size; j++) {
                    ILI9341_DrawPixel(x + x_pos * size + i, y + y_pos * size + j, px);
                }
            }
        }
    }
}

static uint8_t ILI9341_Utf8Decode(const uint8_t* p, uint16_t* out_codepoint) {
    if (p[0] < 0x80) {
        *out_codepoint = p[0];
        return 1;
    }
    if ((p[0] & 0xF0) == 0xE0 && (p[1] & 0xC0) == 0x80 && (p[2] & 0xC0) == 0x80) {
        *out_codepoint = (uint16_t)(((p[0] & 0x0F) << 12) | ((p[1] & 0x3F) << 6) | (p[2] & 0x3F));
        return 3;
    }
    *out_codepoint = '?';
    return 1;
}

void ILI9341_PutString(uint16_t x, uint16_t y, const char* str, uint16_t color, uint16_t bg, uint8_t size) {
    const uint8_t* p = (const uint8_t*)str;
    while (*p) {
        uint16_t cp = 0;
        uint8_t n = ILI9341_Utf8Decode(p, &cp);
        if (cp < 0x80) {
            ILI9341_PutChar(x, y, (char)cp, color, bg, size);
            x += 8 * size;
        } else {
            const uint16_t* glyph = ILI9341_FindGlyph16(cp);
            if (glyph) {
                ILI9341_PutGlyph16(x, y, glyph, color, bg, size);
                x += 16 * size;
            } else {
                ILI9341_PutChar(x, y, ' ', color, bg, size);
                x += 8 * size;
            }
        }
        p += n;
    }
}

void ILI9341_DisplayData(double speed, float weight, GearLevel gear, MotorDirection direction) {
    char buffer[64];
    ILI9341_PutString(10, 10, "--- \xE7\x9B\x91\xE6\xB5\x8B ---", ILI9341_WHITE, ILI9341_BLACK, 1);
    
    snprintf(buffer, sizeof(buffer), "\xE8\xBD\xAC\xE9\x80\x9F:%4.0f  ", speed);
    ILI9341_PutString(10, 40, buffer, ILI9341_GREEN, ILI9341_BLACK, 2);
    ILI9341_PutRMin(160, 40, ILI9341_GREEN, ILI9341_BLACK, 2);
    
    snprintf(buffer, sizeof(buffer), "\xE8\xB5\xB7\xE9\x87\x8D\xE9\x87\x8F:%5.2f T", weight);
    ILI9341_PutString(10, 80, buffer, ILI9341_YELLOW, ILI9341_BLACK, 2);
    
    const char *gear_str;
    switch(gear){
        case GEAR_1: gear_str = "G1"; break;
        case GEAR_2: gear_str = "G2"; break;
        case GEAR_3: gear_str = "G3"; break;
        case GEAR_4: gear_str = "G4"; break;
        case GEAR_5: gear_str = "G5"; break;
        default: gear_str = "--"; break;
    }
    snprintf(buffer, sizeof(buffer), "\xE6\x8C\xA1\xE4\xBD\x8D:%s  ", gear_str);
    ILI9341_PutString(10, 120, buffer, ILI9341_CYAN, ILI9341_BLACK, 2);
    
    const char *dir_str;
    switch(direction){
        case DIRECTION_CW: dir_str = "\xE4\xB8\x8A\xE5\x8D\x87"; break;
        case DIRECTION_CCW: dir_str = "\xE4\xB8\x8B\xE9\x99\x8D"; break;
        case DIRECTION_STOP: dir_str = "\xE5\x81\x9C\xE6\xAD\xA2"; break;
        default: dir_str = "?? "; break;
    }
    snprintf(buffer, sizeof(buffer), "\xE8\xBD\xAC\xE5\x90\x91:%s  ", dir_str);
    ILI9341_PutString(10, 160, buffer, ILI9341_MAGENTA, ILI9341_BLACK, 2);
    
    snprintf(buffer, sizeof(buffer), "\xE6\xA8\xA1\xE5\xBC\x8F:\xE7\x9B\x91\xE6\xB5\x8B   ");
    ILI9341_PutString(10, 200, buffer, ILI9341_BLUE, ILI9341_BLACK, 2);
}
